#include "sosho_L.dtsi"

&spi0 { status = "okay"; };
&glidepoint {
    status = "okay";
    invert-x;
};

// L側トラックパッド（reg = 0）へ接続
&glidepoint_split_L {
    status = "okay";
    device = <&glidepoint>;
};