#include "sosho_R.dtsi"

&spi0 { status = "okay"; };
&glidepoint {
    status = "okay";
    invert-y;
};

// R側トラックパッド（reg = 2）へ接続
&glidepoint_split_R {
    status = "okay";
    device = <&glidepoint>;
};